/dts-v1/;

/*
 * DarkDragon top-level board DTS.
 *
 * This file now consumes only project-owned darkdragon-* include files.
 * Upstream SoC primitives may still be referenced from deeper layers, but the
 * board-facing include chain is under local control.
 */
#include "darkdragon-bcm2710.dtsi"
#include "darkdragon-rpi-family.dtsi"
#include "darkdragon-rpi3-board.dtsi"

/ {
	model = "DarkDragon Raspberry Pi 3 Custom Board";
	compatible = "darkdragon,darkdragon-rpi3", "raspberrypi,3-model-b", "brcm,bcm2837";

	chosen {
		stdout-path = "serial0:115200n8";
	};
};
